#include <stdio.h>
#include <stdlib.h>
#include <ECG-Autocorrelation-500Hz_inferencing.h>

// -------------------------------
// declaring variables and vectors
double        data[5000]   =   {
        -0.05 , -0.05 , -0.05 , -0.05 , -0.05 , -0.05 , -0.05 , -0.05 ,
       -0.05 , -0.049, -0.045, -0.045, -0.046, -0.043, -0.04 , -0.04 ,
       -0.04 , -0.041, -0.038, -0.035, -0.035, -0.028, -0.018, -0.013,
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       -0.01 , -0.01 , -0.01 , -0.01 , -0.01 , -0.01 , -0.01 , -0.01};



double        features[] = {};
double        ndata[5000]   = {0.0};
int           lag = 5000;
int           sizeOfData = 5000;

float   mean, var;

double millisStart, millisEnd;

int raw_feature_get_data(size_t offset, size_t length, float *out_ptr) {
    memcpy(out_ptr, features + offset, length * sizeof(float));
    return 0;
}

// -------------------------------
// instancing functions
void print_inference_result(ei_impulse_result_t result);
void calcMean(void);
void calcVar(void);
void norm(void);
void atc(void);

// -------------------------------
// program setup
void setup()
{
    Serial.begin(115200);

    while (!Serial);
    Serial.println("STARTING...");

    // calculate necessary values
    calcMean();
    calcVar();
    norm();

    // print the starting time
    millisStart = millis();
    Serial.print("Program started at:");
    Serial.print(millisStart);
    Serial.println("ms");

    // calculate the autocorrelation
    atc();
}


void loop()
{
    ei_printf("ECG Autocorrelation 500Hz - ");

/*     if (sizeof(features) / sizeof(double) != EI_CLASSIFIER_DSP_INPUT_FRAME_SIZE) {
        ei_printf("The size of your 'features' array is not correct. Expected %lu items, but had %lu\n",
            EI_CLASSIFIER_DSP_INPUT_FRAME_SIZE, sizeof(features) / sizeof(double));
        delay(1000);
        return;
    } */

    ei_impulse_result_t result = { 0 };

    // the features are stored into flash, and we don't want to load everything into RAM
    signal_t features_signal;
    features_signal.total_length = sizeof(features) / sizeof(features[0]);
    features_signal.get_data = &raw_feature_get_data;

    // invoke the impulse
    EI_IMPULSE_ERROR res = run_classifier(&features_signal, &result, false /* debug */);
    if (res != EI_IMPULSE_OK) {
        ei_printf("ERR: Failed to run classifier (%d)\n", res);
        return;
    }

    // print inference return code
    ei_printf("run_classifier returned: %d\r\n", res);
    print_inference_result(result);

    delay(1000);
}

void print_inference_result(ei_impulse_result_t result) {

    // Print how long it took to perform inference
    ei_printf("Timing: DSP %d ms, inference %d ms, anomaly %d ms\r\n",
            result.timing.dsp,
            result.timing.classification,
            result.timing.anomaly);

    // Print the prediction results (object detection)
#if EI_CLASSIFIER_OBJECT_DETECTION == 1
    ei_printf("Object detection bounding boxes:\r\n");
    for (uint32_t i = 0; i < result.bounding_boxes_count; i++) {
        ei_impulse_result_bounding_box_t bb = result.bounding_boxes[i];
        if (bb.value == 0) {
            continue;
        }
        ei_printf("  %s (%f) [ x: %u, y: %u, width: %u, height: %u ]\r\n",
                bb.label,
                bb.value,
                bb.x,
                bb.y,
                bb.width,
                bb.height);
    }

    // Print the prediction results (classification)
#else
    ei_printf("Predictions:\r\n");
    for (uint16_t i = 0; i < EI_CLASSIFIER_LABEL_COUNT; i++) {
        ei_printf("  %s: ", ei_classifier_inferencing_categories[i]);
        ei_printf("%.5f\r\n", result.classification[i].value);
    }
#endif

    // Print anomaly result (if it exists)
#if EI_CLASSIFIER_HAS_ANOMALY == 1
    ei_printf("Anomaly prediction: %.3f\r\n", result.anomaly);
#endif

}

// function to calculate the mean
void calcMean(void)
{
    mean = 0;

    for (int i = 0; i < sizeOfData; i++)
    {
        mean += data[i];
    }
    mean = mean / sizeOfData;
    Serial.print("mean = ");
    Serial.println(mean, 8);
}

// function to calculate the variance
void calcVar(void)
{
    var = 0;

    for (int i = 0; i < sizeOfData; i++)
    {
        var += ((data[i] - mean) * (data[i] - mean)) / sizeOfData;
    }
    Serial.print("var = ");
    Serial.println(var, 8);
}

// function to normnalize the data
void norm(void)
{
    for (int i = 0; i < sizeOfData; i++)
    {
        ndata[i] = data[i] - mean;
    }
}

void atc(void)
{
  // lag sized loop
  for (int l = 0; l < lag; l++)
  {
      double c = 1.0, sum = 0.0;
      double tmp = 0.0;

      if (l > 0)
      {
          for (int i = l; i < (sizeOfData - 1); i++)
          {
              // calculate the product point by point
              tmp += (ndata[i] * ndata[i - l]);
          }
          c = tmp / sizeOfData / var;
      }

      features[l] = c;

      Serial.print("features[");
      Serial.print(l);
      Serial.print("] = ");
      Serial.println(features[l], 8);
  }

  millisEnd = millis();
  Serial.print("Program ends at:");
  Serial.print(millisEnd);
  Serial.println("ms");

  Serial.print("Autocorrelation execution time:");
  Serial.print(millisEnd - millisStart);
  Serial.println("ms");
}